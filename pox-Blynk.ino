#include <WiFi.h>
#include <BlynkSimpleEsp32.h>
#include "secrets.h"
#include<Wire.h>
#include<MAX30100_PulseOximeter.h>
#include<Adafruit_GFX.h>
#include<gfxfont.h>
#include <Adafruit_SH110X.h>

#define BLYNK_PRINT Serial

#define MAX30i2c_Addr 0x57 
#define Oledi2c_Addr 0x3C 
#define SCREEN_WIDTH 128
#define SCREEN_HEIGHT 64
#define OLED_RESET -1  

#define REPORTING_PERIOD_MS 1000
int c=0;
int n=1;
float BPM, SpO2;
uint32_t tsLastReport = 0;

PulseOximeter pox;
 
Adafruit_SH1106G display = Adafruit_SH1106G(SCREEN_WIDTH, SCREEN_HEIGHT, &Wire, OLED_RESET);

// 'Graphics Bitmap', 128x64px
const unsigned char Fp_Bitmap [] PROGMEM = {
  0x00, 0x00, 0x00, 0x00, 0x00, 0x00, 0x00, 0x00, 0x00, 0x00, 0x00, 0x00, 0x00, 0x00, 0x00, 0x00, 
  0x00, 0x00, 0x00, 0x00, 0x00, 0x00, 0x00, 0x00, 0x00, 0x00, 0x00, 0x00, 0x00, 0x00, 0x00, 0x00, 
  0x00, 0x00, 0x00, 0x00, 0x00, 0x00, 0x00, 0x00, 0x00, 0x00, 0x00, 0x00, 0x00, 0x00, 0x00, 0x00, 
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  0x00, 0x00, 0x00, 0x00, 0x00, 0x00, 0x00, 0x00, 0x00, 0x00, 0x00, 0x00, 0x00, 0x00, 0x00, 0x00 
};

const unsigned char iconBitmap [] PROGMEM = {
  0x00, 0x00, 0x00, 0x00, 0x00, 0x00, 0x00, 0x00, 0x00, 0x00, 0x00, 0x00, 0x00, 0x00, 0x00, 0x00, 
  0x00, 0x00, 0x00, 0x00, 0x00, 0x00, 0x00, 0x00, 0x00, 0x00, 0x00, 0x00, 0x00, 0x00, 0x00, 0x00, 
  0x00, 0x00, 0x00, 0x00, 0x00, 0x00, 0x00, 0x00, 0x00, 0x00, 0x00, 0x00, 0x00, 0x00, 0x00, 0x00, 
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  0x00, 0x00, 0x00, 0x00, 0x00, 0x00, 0x00, 0x00, 0x00, 0x00, 0x00, 0x00, 0x00, 0x00, 0x00, 0x00
};

// 'HM_fp-Grid', 128x64px
const unsigned char HM_WaitBitmap [] PROGMEM = {
  0x00, 0x00, 0x00, 0x00, 0x00, 0x00, 0x00, 0x00, 0x00, 0x00, 0x00, 0x00, 0x00, 0x00, 0x00, 0x00, 
  0x00, 0x00, 0x00, 0x00, 0x00, 0x00, 0x00, 0x00, 0x00, 0x00, 0x00, 0x00, 0x00, 0x00, 0x00, 0x00, 
  0x00, 0x00, 0x00, 0x00, 0x00, 0x00, 0x04, 0x00, 0x00, 0x80, 0x20, 0x10, 0x00, 0x01, 0x00, 0x00, 
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  0x04, 0x00, 0x00, 0x00, 0x00, 0x00, 0x00, 0x00, 0x00, 0x00, 0x00, 0x00, 0x00, 0x00, 0x00, 0x00
};

void setup() {
  // put your setup code here, to run once:
  Serial.begin(115200);
  Blynk.begin(auth, ssid, pass);
//  display.begin(Oledi2c_Addr, true); 
//  if(!display.begin(Oledi2c_Addr,true)) {
//    Serial.println(F("SH1106G allocation failed"));
//    delay(200);
//    for(;;)
//    break;
//  }
//    display.clearDisplay();
//    display.drawBitmap(0, 0, Fp_Bitmap,128, 64, SH110X_WHITE);// WHITE for SSD1306
//  display.display();
//  delay(5000);
//  display.clearDisplay();
//
//  display.clearDisplay();
//    display.drawBitmap(0, 0, iconBitmap,128, 64, SH110X_WHITE);// WHITE for SSD1306
//  display.display();
//  delay(5000);
//
//      display.clearDisplay();
//    display.drawBitmap(0, 0, HM_WaitBitmap,128, 64, SH110X_WHITE);// WHITE for SSD1306
//  display.display();
//  delay(200);
//  display.invertDisplay(1);
//  delay(1000);
//  display.clearDisplay();

//  testdrawchar();
//  display.display();
//  delay(2000);
//  display.clearDisplay();
  

   Serial.print("Initializing Pulse Oximeter.. ");
 pox.begin();
    if (!pox.begin()) {
Serial.println("Failed to allocate i2c to POX");
//displayWait();
delay(200);
for (;;)
break;
}
    else {
Serial.println("SUCCESS!");
Serial.println(" time , Description , BPM , SPO2;");
}

}

void testdrawchar(void) {
  display.setTextSize(1);
  display.setTextColor(SH110X_WHITE);
  display.setCursor(0, 0);

  for (uint8_t i = 0; i < 168; i++) {
    if (i == '\n') continue;
    display.write(i);
    if ((i > 0) && (i % 21 == 0))
      display.println();
  }
  display.display();
  delay(1);
}


void loop() {

pox.update();
Blynk.run();
BPM = pox.getHeartRate();
SpO2 = pox.getSpO2();
//n=1;
//c=0;

    if((BPM != 0) && (SpO2 != 0)){
     if (millis() - tsLastReport > REPORTING_PERIOD_MS)
    {
      Serial.print(",Heart rate & SpO2 , ");
      Serial.print(BPM);
      Serial.print(" , ");
      Serial.println(SpO2);
      c++ ;
        Blynk.virtualWrite(V7, BPM);
        Blynk.virtualWrite(V8, SpO2);

  tsLastReport = millis();
//  for (;;)
//break;
    }
     if (c >= 1100){
        Serial.print(n );
        Serial.println("Person's session complete ");
        c = c - 1100;
        n++;
        }
    }
    if((BPM = 0) && (SpO2 = 0)){
      Serial.println("No Finger");
      delay(800);
     pox.update();
     BPM = pox.getHeartRate();
      SpO2 = pox.getSpO2();
    } 
}
void updateDisplay(void){
    display.clearDisplay();
  display.invertDisplay(0);
  display.setTextSize(1);
  display.setTextColor(SH110X_WHITE);
  display.setCursor(0, 0);
  display.println(" ");
  display.display();
  delay(100);
  display.println(" ");
  display.display();
  delay(100);
  display.setTextSize(2);
  display.setTextColor(SH110X_WHITE);
  display.print("BPM");
  display.display();
  delay(100);
  display.print(" ");
  display.display();
  delay(100);
  display.print(":");
  display.display();
  delay(100);
  display.print(" ");
  display.display();
  delay(100);
  display.println((int)BPM);
  display.display();
  delay(500);
  display.print("SPO2");
  display.display();
  delay(100);
  display.print(":");
  display.display();
  delay(100);
  display.print(" ");
  display.display();
  delay(100);
  display.print((int)SpO2);
  display.display();
  delay(200);
  display.println("%");
  display.display();
  delay(500);
//  display.setTextColor(SH110X_BLACK, SH110X_WHITE); // 'inverted' text
  display.display();
  delay(4000);
  }
